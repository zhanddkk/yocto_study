## build_rzn1_nmc3/conf/bblayers.conf
```bitbake
# POKY_BBLAYERS_CONF_VERSION is increased each time build/conf/bblayers.conf
# changes incompatibly
POKY_BBLAYERS_CONF_VERSION = "2"

BBPATH = "${TOPDIR}"
BBFILES ?= ""

BBLAYERS ?= " \
  /datadisk/zhanlei/git/yocto/poky/meta \
  /datadisk/zhanlei/git/yocto/poky/meta-poky \
  /datadisk/zhanlei/git/yocto/poky/meta-yocto-bsp \
  /yocto/zhanlei/yocto_study/meta-custom \
  /datadisk/zhanlei/git/yocto/meta-openembedded/meta-oe \
  /datadisk/zhanlei/git/yocto/meta-openembedded/meta-python \
  /datadisk/zhanlei/git/yocto/meta-openembedded/meta-networking \
  "
```

## meta-custom/conf/machine/include/rzn1.inc
```bitbake
DEFAULTTUNE ?= "cortexa7thf-vfpv4-d16"

require conf/machine/include/tune-cortexa7.inc

TUNEVALID[vfpv4-d16] = "Enable Vector Floating Point Version 4 (vfpv4-d16) unit."
TUNE_CCARGS_MFPU += "${@bb.utils.contains("TUNE_FEATURES", "vfpv4-d16", " vfpv4-d16", "", d)}"

AVAILTUNES += "cortexa7thf-vfpv4-d16"
ARMPKGARCH_tune-cortexa7thf-vfpv4-d16 = "cortexa7"
TUNE_FEATURES_tune-cortexa7thf-vfpv4-d16 = "${TUNE_FEATURES_tune-armv7athf} vfpv4-d16"
PACKAGE_EXTRA_ARCHS_tune-cortexa7thf-vfpv4-d16 = "${PACKAGE_EXTRA_ARCHS_tune-armv7athf} cortexa7hf-vfpv4-d16"
```

## meta-custom/conf/machine/rzn1-nmc3.conf
```bitbake
#@TYPE: Machine
#@NAME: rzn1-nmc3
#@DESCRIPTION: Machine configuration for the Schneider NMC3 Card"

require conf/machine/include/rzn1.inc
```
